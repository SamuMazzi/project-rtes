## meta-concurrentapp/conf/layer.conf
```bitbake
# We have a conf and classes directory, add to BBPATH
BBPATH .= ":${LAYERDIR}"

# We have recipes-* directories, add to BBFILES
BBFILES += "${LAYERDIR}/recipes-*/*/*.bb \
            ${LAYERDIR}/recipes-*/*/*.bbappend"

BBFILE_COLLECTIONS += "meta-concurrentapp"
BBFILE_PATTERN_meta-concurrentapp = "^${LAYERDIR}/"
BBFILE_PRIORITY_meta-concurrentapp = "6"

LAYERDEPENDS_meta-concurrentapp = "core"
LAYERSERIES_COMPAT_meta-concurrentapp = "honister"
```

## meta-customapp/conf/layer.conf
```bitbake
# We have a conf and classes directory, add to BBPATH
BBPATH .= ":${LAYERDIR}"

# We have recipes-* directories, add to BBFILES
BBFILES += "${LAYERDIR}/recipes-*/*/*.bb \
            ${LAYERDIR}/recipes-*/*/*.bbappend"

BBFILE_COLLECTIONS += "meta-customapp"
BBFILE_PATTERN_meta-customapp = "^${LAYERDIR}/"
BBFILE_PRIORITY_meta-customapp = "6"

LAYERDEPENDS_meta-customapp = "core"
LAYERSERIES_COMPAT_meta-customapp = "honister"
```
